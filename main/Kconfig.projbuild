## main/Kconfig.projbuild
```kconfig
menu "WiFi Camera Configuration"

    menu "WiFi Settings"
        config WIFI_SSID
            string "WiFi SSID"
            default "your_ssid"
            help
                SSID (network name) to connect to.

        config WIFI_PASSWORD
            string "WiFi Password"
            default "your_password"
            help
                WiFi password (WPA2).

        config WIFI_CONNECT_TIMEOUT_MS
            int "WiFi Connection Timeout (ms)"
            default 15000
            range 5000 60000
            help
                Maximum time to wait for WiFi connection in milliseconds.
    endmenu

    menu "Network Settings"
        config MDNS_HOSTNAME
            string "mDNS Hostname"
            default "espcam"
            help
                mDNS hostname for the camera (access via hostname.local).

        config HTTP_SERVER_PORT
            int "HTTP Server Port"
            default 80
            range 1 65535
            help
                Port for the HTTP server.
    endmenu

    menu "Camera Settings"
        config CAMERA_JPEG_QUALITY
            int "JPEG Quality"
            default 12
            range 10 63
            help
                JPEG compression quality. Lower = better quality, larger files.
                10 = best quality, 63 = smallest files.
                Recommended: 10-15 for high quality, 20-30 for balance.

        config CAMERA_FRAME_BUFFERS
            int "Camera DMA Frame Buffers"
            default 2
            range 1 3
            help
                Number of frame buffers for camera DMA.
                More buffers = smoother capture but more memory.
    endmenu

    menu "Streaming Settings"
        config STREAM_FPS
            int "Target Stream FPS"
            default 8
            range 1 15
            help
                Target frames per second for streaming.
                Higher values require more bandwidth and processing.
                Recommended: 3-10 FPS.

        config STREAM_BUFFER_SLOTS
            int "Stream Buffer Slots"
            default 4
            range 2 8
            help
                Number of frame slots in the ring buffer.
                More slots = smoother streaming but more PSRAM usage.

        config STREAM_MAX_FRAME_SIZE
            int "Max Frame Size (bytes)"
            default 102400
            range 51200 204800
            help
                Maximum size of a single JPEG frame in bytes.
                Increase for higher resolutions or quality.
                Default: 102400 (100KB)

        config STREAM_CONSUMER_TIMEOUT_MS
            int "Consumer Timeout (ms)"
            default 1000
            range 100 5000
            help
                How long a consumer waits for a new frame before timeout.
    endmenu

endmenu
```

## sdkconfig.defaults
```kconfig
# ESP32-S3 Target
CONFIG_IDF_TARGET="esp32s3"

# Flash Configuration (ESP32-S3-EYE has 8MB flash)
CONFIG_ESPTOOLPY_FLASHSIZE_8MB=y
CONFIG_ESPTOOLPY_FLASHSIZE="8MB"

# PSRAM Configuration (required for camera buffers)
CONFIG_ESP32S3_SPIRAM_SUPPORT=y
CONFIG_SPIRAM=y
CONFIG_SPIRAM_MODE_OCT=y
CONFIG_SPIRAM_SPEED_80M=y

# Camera buffer in PSRAM
CONFIG_CAMERA_FB_IN_PSRAM=y

# WiFi
CONFIG_ESP_WIFI_STATIC_RX_BUFFER_NUM=16
CONFIG_ESP_WIFI_DYNAMIC_RX_BUFFER_NUM=64
CONFIG_ESP_WIFI_AMPDU_TX_ENABLED=y
CONFIG_ESP_WIFI_AMPDU_RX_ENABLED=y

# HTTP Server
CONFIG_HTTPD_MAX_REQ_HDR_LEN=1024

# Logging
CONFIG_LOG_DEFAULT_LEVEL_INFO=y

# Stack sizes
CONFIG_ESP_MAIN_TASK_STACK_SIZE=8192

# Partition table
CONFIG_PARTITION_TABLE_CUSTOM=y
CONFIG_PARTITION_TABLE_CUSTOM_FILENAME="partitions.csv"

# FreeRTOS
CONFIG_FREERTOS_HZ=1000
CONFIG_FREERTOS_TIMER_TASK_STACK_DEPTH=4096

# Project-specific settings (safe defaults)
# WiFi credentials should be set in sdkconfig.defaults.local (not committed)
CONFIG_MDNS_HOSTNAME="espcam"
CONFIG_HTTP_SERVER_PORT=80
CONFIG_CAMERA_JPEG_QUALITY=12
CONFIG_CAMERA_FRAME_BUFFERS=2
CONFIG_STREAM_FPS=8
CONFIG_STREAM_BUFFER_SLOTS=4
CONFIG_STREAM_MAX_FRAME_SIZE=102400
CONFIG_STREAM_CONSUMER_TIMEOUT_MS=1000
CONFIG_WIFI_CONNECT_TIMEOUT_MS=15000
```

## sdkconfig.defaults.local.example
```kconfig
# Local configuration - Copy to sdkconfig.defaults.local and edit
# This file is NOT committed to version control
#
# Usage:
#   cp sdkconfig.defaults.local.example sdkconfig.defaults.local
#   # Edit sdkconfig.defaults.local with your settings
#   idf.py build

# WiFi credentials (required)
CONFIG_WIFI_SSID="your_wifi_ssid"
CONFIG_WIFI_PASSWORD="your_wifi_password"

# Optional overrides (uncomment to customize)
# CONFIG_MDNS_HOSTNAME="mycamera"
# CONFIG_STREAM_FPS=10
# CONFIG_CAMERA_JPEG_QUALITY=15
```
